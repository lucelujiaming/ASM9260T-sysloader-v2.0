## sysloader-v2.0/Config.in
```kconfig
#
# For a description of the syntax of this configuration file,
# see scripts/kbuild/config-language.txt.
#

mainmenu "Ironpalms Configuration"

config HAVE_DOT_CONFIG
	bool
	default y


menu "System Settings"

choice
	prompt "Choose CPU Type"
	default AS3310D
	help
	 
config AS3310D
	bool "AS3310D"

config AS3310E
	bool "AS3310E"
	
	
endchoice

choice
	prompt "Choose Board Type"
	default BOARD_AS3310_MP4_DEMO
	help
	 
config BOARD_AS3310_MP4_DEMO
	bool "MP4 Demo Board"

config BOARD_AS3310_DEV
	bool "Develop Board"
	
config BOARD_AS3310E_FPGA_QQ
	bool "AS3310E FPGA QQ Board"
	
endchoice

choice
	prompt "Choose CPU Clock"
	default CPU_CLK160
	help
	 
config CPU_CLK180
	bool "360/2 = 180MHz, USB Disable"

config CPU_CLK160
	bool "480/3 = 160MHz, USB ok"
	
config CPU_CLK120
	bool "480/4 = 120MHz, USB ok"
	
config CPU_CLK80
	bool "480/6 = 80MHz, USB ok"
	
config CPU_INTERNAL_CLK120
	bool "Core PLL 240/2 = 120MHz, USB Full Speed ok"
	
endchoice


choice
	prompt "SDRAM Size"
	default SDRAM_8MB
	help	 

config SDRAM_8MB
	bool "8MB"

config SDRAM_16MB
	bool "16MB"
	
endchoice


menuconfig COMMAND_ONLY
	bool "Command Console Support"
	default y
	help
	 Enable Command Console
	 
if COMMAND_ONLY
    
config CMD_MEMFILL	
	bool "memfill"
	default n
	help
         " #memfill ADDR Length data",
         "Fill Memory/Regs with one input data"
	    
config CMD_MEMCMP
	bool "mcmp"
	default n
	help
         " #mcmp src_addr des_addr length",
         "Compare memory"
	    
config CMD_CP
	bool "cp"
	default n
	help
         " #cp src_addr des_addr length",
         "Memory Copy"
	    
config CMD_MEMMOV
	bool "mmov"
	default n
	help
         " #mmov src_addr des_addr length",
         "Memory Move (for overlaped memcpy)");
	    
config CMD_MD
	bool "md"
	default y
	help
         " #md ADDR [Length]",
         "Memory/Reg Display");
	    
config CMD_MW
	bool "mw"
	default n
	help
         " #mw [b w l] ADDR data",
         "Write ONE Memory/Regs 8/16/32 bit mode selectable,no outputs");
	    
config CMD_LOADU
	bool "loadu"
	default n
	help
         " #loadu memaddr",
         "Load a binary file from UART to Memory");
	    
config CMD_RAMTEST
	bool "ramtest"
	default n
	help
         " #ramtest ADDR Length [debug]",
         "test SDRAM");
	    
config CMD_RUN
	bool "run"
	default y
	help
         " #run ADDR [args]",
         "run ASM/C entry application at ADDR (returnable)");
	    
config CMD_SLECTPLAT
	bool "selplat"
	default y
	help
         " #selplat 1/2 (1-win32, 2-linux)",
         "select platform to enable fine display/operation");
	    
config CMD_SETUP
	bool "setup"
	default n
	help
         " #setup [device] [options]\n\
         options:\n\
         1,nand [Cen_num row col PageShift BlockPageShift]\n\
         2,nor Cen_num\n\
         3,sdram Cen row col delay",
         "Setup chosen device ready to work\n\
         Assign pins & call init_functions");   
	    


endif # COMMAND_ONLY


endmenu

menu "Build Settings"


config BOOT_HEADER
	bool "Build with Uart Header"
	default n
	help
	 Build with UART header, using asTTY to Boot
	 if you want to Boot using USB or Nand, do NOT choose     

config CFLAG_WALL
	bool "Add Compiler with -Wall Option"
	default n
	help
	 Add Compiler with -Wall Option

config DEBUG_MODE
	bool "Debug Mode"
	default n
	help
	 Debug Mode , with Nand write command    

   
config IRQ_AS3310D
	bool "Enable IRQ"
	default y
	depends on AS3310D
	select IRQ
	help
	 Enable Interrupt
	 
config IRQ_AS3310E
	bool "Enable IRQ"
	default y
	depends on AS3310E
	select IRQ
	help
	 Enable Interrupt
 

config PIN_CONTROL
	bool "Enable PIN CONTROL"
	default y
	help
	 Enable Pin Control

config TIMER
	bool "Enable System Timer"
	default y
	help
	 Enable System Timer
	 
config TIMER_1
	bool "Enable Timer 1"
	default n
	depends on TIMER
	help
	 Enable Timer 1

config TIMER_DEBUG
	bool "System Timer Debug"
	default n
	depends on TIMER
	help
	 System Timer Debug Message
	 
config TIMER_LIST
	bool "System Timer List Support"
	default n
	depends on TIMER
	help
	 System Timer List , support add_timer. mod_timer

config TIMER_LIST_DEBUG
	bool "System Timer List Debug"
	default n
	depends on TIMER_LIST
	help
	 System Timer List Debug Message

config ENABLE_DMA
	bool "DMA support"
	default y
	help
	 enable dma support
	 
endmenu




source drivers/Config.in

comment " "
comment "Applications --- "
comment " "
```

## sysloader-v2.0/drivers/Config.in
```kconfig
#
# For a description of the syntax of this configuration file,
# see scripts/kbuild/config-language.txt.
#


menu "Test Device Settings"

source drivers/Config_usb.in	 


menuconfig LCD
	bool "LCD"
	default y
	depends on ENABLE_DMA && IRQ
	help
	 LCD support
if LCD

choice
	prompt "LCD Type"
	depends on LCD
	default LCD_CONTROL
	help
	 determine which kind of lcd to output
	 
config LCD_CONTROL
	bool "LCD Contorller"
	help
	 Enable LCD Contorller
 
config LCD_IF
	bool "LCD Interface"

endchoice


choice
	prompt "LCDIF Panel"
	depends on LCD_IF
	default LCD_240x320
	help
	 choose lcd interface panel

config LCD_240x320
	bool "lcdif 240x320"
	help

endchoice


choice
	prompt "LCD Panel"
	depends on LCD_CONTROL
	default ILI_9320RGB
	help
	 choose lcd panel
 
config ILI_9320RGB
	bool "Ili9320 QVGA RGB Interface LCD"
	select GPIO_SPI
	help	
	 This is an implementation of the ILI9320 LCD ,
	 a 3.5" RGB Interface 262K color QVGA.
	 The native resolution is 240*320.	 
	
config TRUELY_43
	bool "Truely 4.0\" Wide Screen 480x272 TFT LCD"
	help
	 This is an implementation of the Truely 4.0" 480x272 TFT LCD.

endchoice


choice
	prompt "LCD CONTROL DMA MODE"
	depends on LCD_CONTROL
	default LCD_IRQ
	help
	 choose lcd panel
 
config LCD_IRQ
	bool "LCD Control Use IRQ Mode"
	help	
	
config LCD_CYCLED
	bool "LCD Control Use Cycle Mode"
	help

endchoice

endif # LCD

config ASC_DISPLAY
	bool "Enable Asc output in lcdif"
	default n
	depends on LCD_IF
	help
	 Enable Asc output in lcdif      


menuconfig NAND2
	bool "Nand Flash 2"
	default y
	help
	 Enable Nand Flash
	 
if NAND2

config NAND2_VERIFY
	bool "Enable Nand Flash Write Page Verify"
	default n
	depends on NAND
	help
	 read back data from nand, and verify data using ecc
	 
endif    

menuconfig SPI_FLASH
	bool "SPI Flash"
	default n
	help
	 Enable Spi Flash boot
    


menuconfig NAND
	bool "Nand Flash"
	default y
	help
	 Enable Nand Flash
	 
if NAND
    
config NAND_VERIFY
	bool "Enable Nand Flash Write Page Verify"
	default n
	depends on NAND
	help
	 read back data from nand, and verify data using ecc
	 
config NAND_USE_OWN_BUFFER
	bool "Nand Flash R/W Use driver's own buffer"
	default y
	depends on NAND
	help
	 nand flash read/write ops use driver's own 
	 none-cached, 32-aligned buffer
	 
config AFTL
	bool "Enable AFTL"
	default y
	depends on NAND
	help
	 Enable AFTL
	 
config AFTL_RESERVED_SIZE_MB
	int "AFTL Reserved Boot Size (MB)"
	default 16
	depends on AFTL
	help
	 AFTL Reserved Boot Size (MB)

choice
	prompt "AFTL_SIZE"
	depends on AFTL
	default LCD_CONTROL
	help
	 determine which kind of lcd to output
	 
config AFTL_SIZE_ALL
	bool "Use all available spaces"
 
config AFTL_SIZE_XXMB
	bool "Size MB"

endchoice

config AFTL_SIZE_MB
	int "Set AFTL Size (MB)"
	default 64
	depends on AFTL_SIZE_XXMB
	help
	 AFTL Size (MB)

config AFTL_DEBUG
	bool "AFTL Debug Message"
	default n
	depends on AFTL
	help
	 AFTL Debug Message    
	 
endif # NAND


menuconfig DEVMEM
	bool "Memory Device"
	default n
	help
	 Enable a Memory Block Device
	 
if DEVMEM

config DEVMEM_IN_SDRAM
	bool "Memory Device in SDRAM"
	default y
	depends on DEVMEM
	help
	 Memory Device in SDRAM
	 
config DEVMEM_SDRAM_BASE
	string "Memory Device Base Address in SDRAM"
	default 0x20000000
	depends on DEVMEM_IN_SDRAM
	help
	 Memory Device Base Address
	 
config DEVMEM_SIZE_KB
	int "Memory Device Size (KB)"
	default 2048
	depends on DEVMEM
	help
	 Memory Device Size in KB
	 
config DEVMEM_DEBUG_CMD
	bool "Debug Command for Memory Device"
	default n
	depends on DEVMEM
	help
	 Debug Command for Memory Device	 

endif #DEVMEM

config GPIO_SPI
	bool "GPIO_SPI"
	depends on TIMER && IRQ
	default y
	help
	 Enable GPIO_SPI
	 
config RTC
	bool "RTC"
	default y
	help

config I2C
	bool "I2C"
	default y
	help

config SOUND
	bool "SOUND"
	depends on ENABLE_DMA
	default y
	help

config SOUND_AS3310_SND_DEBUG
	bool "Sound Debug"
	depends on SOUND
	default n
	help
 
config SOUND_DRIVER_TEST
	bool "Fake Mp3 Decode & Driver Test"
	default n
	depends on SOUND && COMMAND_AND_TASK
	help
	 let a memcopy simulate the decode to test driver
       
config SYS_MONITOR
	bool "System Monitor"
	depends on TIMER && BOARD_AS3310_MP4_DEMO
	default n
	help
	
config PWM
	bool "Pwm Generator"
	#depends on TIMER
	default n
	help
	
config SD_MMC
       bool "SD/MMC card Driver"
       default n
       help
       
config FM_RADIO
       bool "FM Radio Driver"
       default n
       help
           
config FM_USE_AD_DA_LOOP
       bool "FM USE AD/DA Loop"
       depends on FM_RADIO
       default n
       help
	if choose, fm audio will pass the adc to dac then to headerphone AP
	else it will direct to headerphone AP


endmenu
```
